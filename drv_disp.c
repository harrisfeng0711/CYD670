//==============================================//
//			INCLUDE HEAER FILE					//
//==============================================//
#include "system.h"

//==============================================
//	查表資料
//==============================================
const U8 tabSeg [] = 		 // 共陰
{ 	 		//   .gfa bdec	
	0x3F,   //0b 0011 1111,    // '0'
	0x09,   //0b 0000 1001,    // '1'
	0x5E,   //0b 0101 1110,    // '2'
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	0x6B,	//0b 0110 1011,    // 'H' 17
	0x43	//0b 0100 0011	   // 'n' 18
};



//==============================================//
//				暫存器定義						//
//==============================================//
U8 bSeg0 = 0x0;
U8 bSeg1 = 0x0;
U8 bSeg2 = 0x0;
ubyte bLed = {0x0};
U8 bScanCnt = 0;


//==============================================//
//				函式原型宣告					//
//==============================================//
void pConDisp (U16 dat,U8 dot);
void pScanDisp (void);
void pClrDisp (void);


//==============================================//
//				display scan					//
//==============================================//
void pConDisp (U16 dat,U8 dot)
{
	U8 s0,s1,s2;
	
	s0=dat%10;
	dat/=10;
	s1=dat%10;
	s2=dat/10;
	
	bSeg0 = ~tabSeg[s0];
	bSeg1 = ~tabSeg[s1];
	bSeg2 = ~tabSeg[s2];
	
	if (dot==1)
		bSeg1 &= 0x7F;	// 小數點
	
}
//==============================================//
//				display scan					//
//==============================================//
void pScanDisp (void)
{
	// 掃瞄按鍵前已關閉 S0~S3
	switch (bScanCnt)
	{
		case 0:
			PORTC = bLed.byte;
			oS0 = 0;
			break;
		case 1:
			PORTC = bSeg1;
			oS1 = 0;
			break;
		case 2:
			PORTC = bSeg2;
			oS2 = 0;
			break;
		case 3:
			PORTC = bSeg0;
			oS3 = 0;
			break;
	}
	
	if (++bScanCnt > 3)
		bScanCnt = 0;
}

//==============================================//
// clear display 
//==============================================//
void pClrDisp (void)
{
	bSeg0 = ~tabSeg[dNull];
	bSeg1 = ~tabSeg[dNull];
	bSeg2 = ~tabSeg[dNull];
	bLed.byte = 0xff;
}

	